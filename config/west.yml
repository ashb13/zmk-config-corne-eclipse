## config/west.yml
```yaml
manifest:
  defaults:
    revision: v0.3
  remotes:
    - name: zmkfirmware
      url-base: https://github.com/zmkfirmware
    - name: frosthaven
      url-base: https://github.com/Frosthaven
    - name: aym1607
      url-base: https://github.com/AYM1607
    - name: petejohanson
      url-base: https://github.com/petejohanson
  projects:
    - name: zmk
      remote: frosthaven
      revision: v0.3-peripheral-charging-bit
      import: app/west.yml
    - name: zmk-ext-power-smart-idle
      remote: frosthaven
      # Pinned to b558980 = 6511488 + clean USB-idle-timeout feature. The
      # commits between dropped DT_NODELABEL/DT_COMPAT change and boot-grace
      # flag that broke on-battery auto-off and caused wrong RGB color.
      revision: b558980
    - name: zmk-driver-azoteq-iqs5xx
      remote: aym1607
      revision: main
    - name: cirque-input-module
      remote: petejohanson
      revision: main
  self:
    path: config
```
